
//define symbol __code_entry__		= 0x30700000; 		// 		代码空间 开始地址
define symbol __ICFEDIT_region_SDRAM_start__ = 0x30780000;
define symbol __ICFEDIT_region_SDRAM_end__   = 0x30800000;

/**** End of ICF editor section. ###ICF###*/

define memory mem with size = 4G;
define region SDRAM_region = mem:[from __ICFEDIT_region_SDRAM_start__ to __ICFEDIT_region_SDRAM_end__];

initialize by copy with packing = none{ readwrite};
place at address mem:__ICFEDIT_region_SDRAM_start__ 	{ readonly section .code_entry };

place in SDRAM_region { readwrite };
place in SDRAM_region { readonly };
